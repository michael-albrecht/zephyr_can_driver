## drivers/can/Kconfig.sam
```kconfig
DT_COMPAT_ATMEL_SAM_MCAN := atmel,sam-mcan
DT_COMPAT_ATMEL_SAM0_MCAN := atmel,sam0-mcan

config CAN_SAM
	bool "SAM MCAN Driver"
	default $(dt_compat_enabled,$(DT_COMPAT_ATMEL_SAM_MCAN))
	select CAN_MCAN

config CAN_SAM0
	bool "SAM0 MCAN Driver"
	default $(dt_compat_enabled,$(DT_COMPAT_ATMEL_SAM0_MCAN))
	select CAN_MCAN
```

## drivers/can/Kconfig.sam0
```kconfig
DT_COMPAT_ATMEL_SAM0_MCAN := atmel,sam0-mcan

config CAN_SAM0
	bool "SAM0 MCAN Driver"
	default $(dt_compat_enabled,$(DT_COMPAT_ATMEL_SAM0_MCAN))
	select CAN_MCAN
```

## dts/bindings/can/atmel,sam-mcan.yaml
```yaml
description: Bosch m_can CAN-FD controller

compatible: "atmel,sam-mcan"

include: bosch-mcan.yaml

properties:
    peripheral-id:
      type: array
      description: peripheral ID
      required: true
      
    pinctrl-0:
      type: phandles
      required: false
      description: |
        PIO pin configuration for TX and RX signals.  We expect that
        the phandles will reference pinctrl nodes.  These nodes will
        have a nodelabel that matches the Atmel SoC HAL defines and
        be of the form p<port><pin><periph>_<inst>_<signal>.
```

## dts/bindings/can/atmel,sam0-mcan.yaml
```yaml
description: Bosch m_can CAN-FD controller

compatible: "atmel,sam0-mcan"

include: bosch-mcan.yaml

properties:
    clocks:
      required: true

    clock-names:
      required: true
```
